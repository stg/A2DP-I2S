// Audio provides the I2S+A2DP+AVRCP back-end: source switching, event generation, synthesis, mixing, fading, clock tracking and sample rate conversion

#include <driver/gpio.h>
#include <ESP_I2S.h>
#include <BluetoothA2DPSink.h>
#include <mp3dec.h>
#include "Audio.h"
#include "TAS5828M.h"
#include "SGTL5000.h"
#include "Biquad.h"
#include "Resources.h"
#include "Comm.h"

// I²S (codec/amp audio signals)
#define I2S_BCK GPIO_NUM_19  // Bit clock (SCK)
#define I2S_WCK GPIO_NUM_18  // Word clock (LRCLK/WS)
#define I2S_TXD GPIO_NUM_21  // Transmit data (SDOUT)
#define I2S_RXD GPIO_NUM_4   // Receive data (SDIN)
#define I2S_MCK GPIO_NUM_0   // Master clock (MCLK)

// Convert bytes to samples
#define SAMPLES(BYTES) ((BYTES) >> 2)  // Stereo, 16-bit

// Buffer levels (in bytes)
#define BUFFER_SIZE    32000
#define BUFFER_NOMINAL 24000
#define BUFFER_LOW      8000

// MP3 decoding
#define MP3_BUFFER_SIZE (MAX_NCHAN * MAX_NGRAN * MAX_NSAMP)

// A2DP streaming must be stable for at least this many chunks before an event is generated (for source switch, for example)
#define STABILITY_COUNT_IN  600
#define STABILITY_COUNT_OUT 3600

// Size of event queue
#define EVENT_QUEUE_SIZE 16

// Half-band kernel for SRC (polyphase_dude.py -n1 -t31 -msinc-kaiser -p7 -q27 -beven -s)
// Stage 1 of the SRC: integer up-sampling by 2, allowing use of a much shorter polyphase filter
#define SRC2X_Q 27
static const uint32_t DRAM_ATTR src_2x_kernel[] = {
  0xFFFF7C08, 0x00045C26, 0xFFF08C80, 0x002827BD, 0xFFA7908A, 0x00B42B29, 0xFE82B90E, 0x0504FED3,
  0x0504FED3, 0xFE82B90E, 0x00B42B29, 0xFFA7908A, 0x002827BD, 0xFFF08C80, 0x00045C26, 0xFFFF7C08
};

// Polyphase filterbank for SRC (polyphase_dude.py -n256 -t16 -msinc-kaiser -p7 -f0.4535 -q27 -s)
// Stage 2 of the SRC: fractional down-sampling with low-pass
// Would have liked to place in slightly faster DRAM, but it's just too big without PSRAM
#define SRCPP_PHASES_W 8
#define SRCPP_PHASES (1 << SRCPP_PHASES_W)
#define SRCPP_TAPS 16
#define SRCPP_Q 27
static const uint32_t /*DRAM_ATTR*/ src_polyphase_filterbank[SRCPP_PHASES][SRCPP_TAPS] =  {
    { 0xFFFE111C, 0x0009A6CF, 0x0017CEA8, 0xFFDA4C52, 0xFF85417C, 0x004B9866, 0x0263AAA9, 0x03A05F0D, 0x0265CD75, 0x004D3878, 0xFF854290, 0xFFD9DFAB, 0x0017C41E, 0x0009BC6F, 0xFFFE12C9, 0xFFFF8E06 },
    { 0xFFFE0F7C, 0x0009913E, 0x0017D8E0, 0xFFDAB8BA, 0xFF85417F, 0x0049F9FB, 0x02618774, 0x03A05CFC, 0x0267EFD7, 0x004EDA30, 0xFF8544BC, 0xFFD972C5, 0x0017B943, 0x0009D21D, 0xFFFE1483, 0xFFFF8C54 },
    { 0xFFFE0DEB, 0x00097BB9, 0x0017E2C3, 0xFFDB24EA, 0xFF8542B2, 0x00485D28, 0x025F6358, 0x03A05818, 0x026A114B, 0x00507D7E, 0xFF85481D, 0xFFD905A9, 0x0017AE12, 0x0009E7D6, 0xFFFE164D, 0xFFFF8AA0 },
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    { 0xFFFF8E06, 0xFFFE12C9, 0x0009BC6F, 0x0017C41E, 0xFFD9DFAB, 0xFF854290, 0x004D3878, 0x0265CD75, 0x03A05F0D, 0x0263AAA9, 0x004B9866, 0xFF85417C, 0xFFDA4C52, 0x0017CEA8, 0x0009A6CF, 0xFFFE111C },
};

// Sine table (Q30)
#define SINE_BITS  7                        // Sine table depth
#define SINE_FMASK ((1 << SINE_FBITS) - 1)  // Sine table fraction mask
#define SINE_FBITS (32 - 2 - SINE_BITS)     // Sine table fractional bits
const int32_t sine_table[] = {
  0x00000000, 0x00c90e8f, 0x0192155f, 0x025b0cae, 0x0323ecbe, 0x03ecadcf, 0x04b54824, 0x057db402,
  0x0645e9af, 0x070de171, 0x07d59395, 0x089cf867, 0x09640837, 0x0a2abb58, 0x0af10a22, 0x0bb6ecef,
  0x0c7c5c1e, 0x0d415012, 0x0e05c135, 0x0ec9a7f2, 0x0f8cfcbd, 0x104fb80e, 0x1111d262, 0x11d3443f,
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  0x40000000, // <= space potato!
}; // <= sad monkey?

// 32-bit signed multiply -> 32-bit result, add 32-bit (ARM: SMMLAR)
// floating point equivalent: return c + a * b
static inline __attribute__((always_inline)) int32_t smmlar(int32_t a, int32_t b, int32_t c) {
  int32_t result;
#if defined(__ARMCC_VERSION) && (__CORTEX_M >= 0x04U)
  __asm{ smmlar result, a, b, c }
#elif defined(__GNUC__) && defined(__arm__) && (__CORTEX_M >= 0x04U)
  __asm("smmlar %0, %1, %2, %3":"=r"(result):"r"(a),"r"(b),"r"(c));
#else
  result = c + ((((int64_t)a * b) + 0x80000000) >> 32);
#endif
  return result;
}

// Linear interpolator
static inline __attribute__((always_inline)) int32_t linear(int32_t y1, int32_t y2, uint32_t mu) {
  return smmlar((y2 >> 1) - (y1 >> 1), mu >> 1, y1 >> 2) << 2;
}

// Cubic interpolation
// y0...y3 need to be externally limited in range to prevent overflow
// y0...y3 are control points, interpolation is performed between y1 and y2
// mu is interpolation point 00000000-FFFFFFFF
// floating-point equivalent return y1+mu/2*(y2-y0+mu*(2*y0-5*y1+4*y2-y3+mu*(3*(y1-y2)+y3-y0)))
static int32_t cubic(int32_t y0, int32_t y1, int32_t y2, int32_t y3, uint32_t mu) {
  mu >>= 1;
  int32_t a = (3 * (y1 - y2) - y0 + y3);
  int32_t b = 2 * y2 + y0 - (5 * y1 + y3) / 2;
  int32_t c = (y2 - y0) / 2;
  return smmlar(smmlar(smmlar(a, mu, b) << 1, mu, c) << 1, mu, y1);
}

// Sin by table lookup with interpolation for pha (1<<32==M_PI*2)
static int32_t sine(uint32_t pha) {
  uint32_t fraction = (pha & SINE_FMASK) << (2 + SINE_BITS);
  uint32_t index = (pha & 0x40000000) ? (0x40000000 + SINE_FMASK - (pha & 0x3FFFFFFF)) : (pha & 0x3FFFFFFF);
  uint32_t indexa = index >> SINE_FBITS;
  int32_t indexb = pha & 0x40000000 ? (int32_t)indexa - 1 : (int32_t)indexa + 1;
  int32_t sample = linear(sine_table[indexa], sine_table[indexb], fraction);
  return pha & 0x80000000 ? -sample : sample;
}

// See sine
static inline __attribute__((always_inline)) int32_t cosine(uint32_t pha) {
  return sine(pha + 0x40000000);
}

// Which sample-rate-converter to use?
// Best enabled will be used, with fall-back to ZOH
constexpr bool polyphase_src = true;
constexpr bool cubic_src = false;
constexpr bool linear_src = false;

// Perform dithering (applies only to polyphase SRC)
constexpr bool shaped_dither = true;

// Taps required for selected SRC
constexpr uint32_t taps_src = polyphase_src ? SRCPP_TAPS : (cubic_src ? 4 : (linear_src ? 2 : 1));

// Use biquad filtered clock-drift-tracker
constexpr bool biquad_cdt = true;

// Buffer for incoming A2DP stream
static uint8_t __attribute__((aligned(4))) buffer[BUFFER_SIZE];
static uint8_t __attribute__((aligned(4))) chunk[AUDIO_CHUNK_SIZE];
static uint8_t *buffer_head = buffer;
static uint8_t *buffer_tail = buffer;
static size_t volatile buffer_fill = 0;
static SemaphoreHandle_t buffer_access;

// Faders
static int16_t fader_buffer;
static int16_t fader_commanded;
static int16_t fader;
static bool    volatile fade_request = false;

// A2DP streaming state
static bool streaming = false;
static uint16_t streaming_stable;
static uint16_t connected_counter;

// Synthesizer
static bool volatile synthesis_request = false;
static bool synthesis = false;
static size_t volatile synthesis_mp3_size;
static const unsigned char * volatile synthesis_mp3_data;
static sweep_data synthesis_sweep_seed;

// Log-sweep
static sweep_data synthesis_sweep_data;

// Current audio input source
static audio_source source;

// Clock-Drift-Tracker
static biquad_filter_q cdt_filter;
static biquad_history_q cdt_history[2];
static int64_t cdt_integrator;

// Sample-Rate-Converter
static int16_t  src_2x[SRCPP_TAPS + 2][2]; // Micro buffer for 2x upsampling
static uint32_t src_2x_index = 0; 
static uint16_t sink_samplerate; // configured, not measured
static uint16_t source_samplerate; // reported, not measured
static uint32_t src_nominal = 0x40000000; // nominal conversion factor, calculated, Q30
static uint32_t src_rate = src_nominal; // conversion factor, measured, Q30
static uint32_t src_rate_internal = src_rate;
static uint32_t dst_rate = 0x1000000000000000 / src_nominal;
static uint32_t src_phase = 0;

// Pointer to I2S object
static i2s_chan_handle_t rx_chan = NULL;
static i2s_chan_handle_t tx_chan = NULL;

// PRNG
static uint32_t rng_state = 2463534242u;

// Dithering
static int16_t noise_last[2] = {0, 0};
static int16_t noise_error[2];

// Export audio driver
Audio_Driver Audio;

// MP3 decoding
static int16_t mp3_buffer[MP3_BUFFER_SIZE];
static size_t mp3_buffer_index;
static size_t mp3_buffer_fill;
static HMP3Decoder mp3_decoder;
static MP3FrameInfo mp3_info;
static uint8_t *mp3_data;
static int mp3_size;

// Metadata callback
static void (* volatile cb_metadata)(uint8_t, const char *, size_t);
static void (* volatile cb_connection)(bool, const char *, size_t);
static void (* volatile cb_audiodata)(int16_t *, bool);
static void (* volatile cb_eventhandler)(audio_event);

// Event queue
QueueHandle_t eventQueue;
TaskHandle_t eventHandler = NULL;

// Fast PRNG (xorshift32)
static inline uint32_t xorshift32(void) {
  uint32_t x = rng_state;
  x ^= x << 13;
  x ^= x >> 17;
  x ^= x << 5;
  rng_state = x;
  return x;
}

// TPDF noise generator
static inline int16_t tpdf_noise(void) {
  int32_t n1 = (int16_t)(xorshift32() & 0xFFFF);
  int32_t n2 = (int16_t)(xorshift32() & 0xFFFF);
  return (int16_t)((n1 - n2) >> 1);
}

// Shaped noise generator (1st order hp)
static inline int16_t shaped_noise(uint8_t ch) {
    int16_t n = tpdf_noise();
    int16_t shaped = n - noise_last[ch]; // simplest high-pass
    noise_last[ch] = n;
    return shaped;
}

// Single-sample convolution
static inline __attribute__((always_inline)) int64_t convolve_q16q32(int16_t *signal, uint8_t signal_stride_w, const int32_t *kernel, size_t kernel_size) {
  int64_t acc = 0;
  while(kernel_size--) {
    acc += ((int64_t)*signal * *kernel++);// >> (16 - (30 - SRCPP_Q));
    signal += (1 << signal_stride_w);
  }
  return acc;
}

// Single-sample convolution on a circular signal buffer
static int32_t convolve_q16q32_circular(int16_t *signal, uint8_t signal_stride_w, typeof(signal) buffer_start, typeof(signal) buffer_end, const int32_t *kernel, size_t kernel_length) {
  if(signal + (kernel_length << signal_stride_w) > buffer_end) {
    size_t len0 = ((uintptr_t)buffer_end + sizeof(*signal) - ((uintptr_t)signal)) / (sizeof(*signal)) >> signal_stride_w;
    size_t len1 = kernel_length - len0;
    return ((convolve_q16q32(signal, signal_stride_w, kernel, len0)
           + convolve_q16q32(buffer_start + ((signal + (len0 << signal_stride_w) - buffer_end)), signal_stride_w, kernel + len0, len1)) + (1 << 15)) >> 16;
  } else {
    return (convolve_q16q32(signal, signal_stride_w, kernel, kernel_length) + (1 << 15)) >> 16;
  }
}

/*
// Single-sample convolution
static inline __attribute__((always_inline)) int64_t convolve_q16q32(int16_t *signal, uint8_t signal_stride_w, const int32_t *kernel, size_t kernel_size) {
  int64_t acc = 0;
  while(kernel_size--) {
    acc += ((int64_t)*signal * *kernel++);
    signal += (1 << signal_stride_w);
  }
  return acc;
}

// Single-sample convolution on a circular signal buffer
static int32_t convolve_q16q32_circular(int16_t *signal, uint8_t signal_stride_w, typeof(signal) buffer_start, typeof(signal) buffer_end, const int32_t *kernel, size_t kernel_length) {
  if(signal + (kernel_length << signal_stride_w) > buffer_end) {
    size_t len0 = ((uintptr_t)buffer_end + sizeof(*signal) - ((uintptr_t)signal)) / (sizeof(*signal)) >> signal_stride_w;
    size_t len1 = kernel_length - len0;
    return (convolve_q16q32(signal, signal_stride_w, kernel, len0)
           + convolve_q16q32(buffer_start + ((signal + (len0 << signal_stride_w) - buffer_end)), signal_stride_w, kernel + len0, len1)) >> 16;
  } else {
    return convolve_q16q32(signal, signal_stride_w, kernel, kernel_length) >> 16;
  }
}
*/

// Reset clock-drift-tracker and sample-rate-converter
static void cdt_reset() {
  src_rate = src_nominal;
  cdt_history[0] = cdt_history[1] = {};
  cdt_integrator = 0;
}

class MyA2DPSink : public BluetoothA2DPSink {
public:
    
    template <class... Args> explicit MyA2DPSink(Args&&... args) : BluetoothA2DPSink(std::forward<Args>(args)...){}

    void app_gap_callback(esp_bt_gap_cb_event_t event, esp_bt_gap_cb_param_t *param) override {
        if(preemption) {
            
          switch(event) {
            case ESP_BT_GAP_ACL_CONN_CMPL_STAT_EVT: {
              ESP_LOGI(BT_AV_TAG, "ESP_BT_GAP_ACL_CONN_CMPL_STAT_EVT");
              if(is_connected()) {
                memcpy(pending_new_peer, param->acl_conn_cmpl_stat.bda, ESP_BD_ADDR_LEN);
                esp_a2d_disconnect(pending_new_peer);
                disconnect();
              }

            } break;
          }
        }
        BluetoothA2DPSink::app_gap_callback(event, param);
    }

    void enable_preemption(bool enable) {
        preemption = enable;
    }

private:
    bool preemption = false;
};


// Audio driver
class MyA2DPOutput : public BluetoothA2DPOutput {
public:
  MyA2DPOutput() {}

  // Supply BluetoothA2DPOutput requirements
  bool begin() {
    return true;
  };
  void end() override {}
  void set_output_active(bool active) override{};

  // Seed the sample-rate-converter with an appropriate factor
  void set_sample_rate(int rate) override {
    //Comm.printf("Sample rate configured: %u\n", rate);
    source_samplerate = rate;
    src_nominal = (uint64_t)0x40000000 * source_samplerate / sink_samplerate;
    cdt_reset();
  };

  // Write A2DP stream to buffer (called from A2DP sink)
  size_t write(const uint8_t *data, size_t _len) override {
    size_t buffer_free = BUFFER_SIZE - buffer_fill;
    size_t len = ((_len > buffer_free) ? buffer_free : _len);

    uint8_t *buffer_end = buffer + sizeof(buffer);
    if(buffer_head + len > buffer_end) {
      size_t len0 = buffer_end - buffer_head;
      size_t len1 = len - len0;
      memcpy(buffer_head, data, len0);
      memcpy(buffer, data + len0, len1);
      buffer_head = buffer + len1;
    } else {
      memcpy(buffer_head, data, len);
      buffer_head += len;
    }
    if(buffer_head >= buffer_end) buffer_head -= sizeof(buffer);

    xSemaphoreTake(buffer_access, portMAX_DELAY);
    buffer_fill = buffer_fill + len;
    xSemaphoreGive(buffer_access);

    return len;
  }
};

// Import audio objects
static I2SClass i2s_device;
static MyA2DPOutput a2dp_output;
static MyA2DPSink a2dp_sink(a2dp_output);

// Reads A2DP stream from buffer 
//   Does NOT check if enough data is available, because of this must be called as follows:
//     A) Call with chunk==null to activate new SRC ratio, and return calculated available buffer level
//        Due to SRC ratio changes this call may lower the buffer level, voiding previous values
//     B) Read from buffer (multiple calls possible, if required), process CDT and calculate new SRC ratio
//        It is absolutely necessary to call A) first to check that the chunks requested are available
//        The buffer level reported by A is guaranteed until next call to A
static size_t read_a2dp_chunk(uint8_t *chunk_out) {

  // Accept new conversion rate and return calculated available bytes after SRC
  if(chunk_out == NULL) {

    // Activate new SRC ratio and calculate its reciprocal by expensive 64-bit division
    src_rate_internal = src_rate;
    dst_rate = 0x1000000000000000 / src_rate_internal;

    // Buffer level in samples (minus taps, so that convolution is always possible)
    uint32_t buffer_available = SAMPLES(buffer_fill);
    if(buffer_available > (taps_src - 1)) buffer_available -= (taps_src - 1);
    else buffer_available = 0;

    // Multiply buffer size by calculated relative conversion rate and return as number of bytes
    // At least this many sample-rate-converted bytes are guaranteed to be available for reading
    // May look sketchy, but this guarantee has been verified (see trial_*.cpp)
    return (uint32_t)(((int64_t)buffer_available * dst_rate) >> 28);

  }

  // Transfer samples from input buffer to output chunk
  int16_t(*dst)[2] = (typeof(dst))chunk_out;
  int16_t(*src)[2] = (typeof(src))buffer_tail;
  int16_t *buffer_end = (typeof(buffer_end))&buffer[sizeof(buffer)];
  size_t samples = SAMPLES(AUDIO_CHUNK_SIZE);
  size_t bytes_read = 0;

  // Set up input buffer fader
  int32_t fadeout_from_index = SAMPLES(buffer_fill);
  if(fadeout_from_index > taps_src) fadeout_from_index -= taps_src;
  else fadeout_from_index = 0;
  fadeout_from_index = SAMPLES((fadeout_from_index << 2) - (BUFFER_LOW + AUDIO_CHUNK_SIZE));

  while(samples--) {
    // Sample input by...
    if(polyphase_src) {
      const int32_t *kernel = (int32_t*)src_polyphase_filterbank[(src_phase / (0x20000000 / SRCPP_PHASES)) & (SRCPP_PHASES - 1)];
      for(uint8_t ch = 0; ch < 2; ch++) {
        int32_t sample = 0;
        // ...convolution with the appropriate phase from the polyphase filterbank
        sample = convolve_q16q32_circular(&src_2x[src_2x_index + src_phase / 0x20000000][ch], 1, (int16_t *)src_2x, (int16_t *)(src_2x + SRCPP_TAPS + 2), kernel, SRCPP_TAPS);
        sample += (1 << (SRCPP_Q - 17)); // Apply rounding correction
        // Apply dithering
        if(shaped_dither) {
          sample += (shaped_noise(ch) >> (32 - SRCPP_Q)) + noise_error[ch];
          noise_error[ch] = sample - ((sample >> (SRCPP_Q - 16)) << (SRCPP_Q - 16));
        }
        // Scale, saturate, fade, write
        sample >>= (SRCPP_Q - 16);
        if(sample > +32767) sample = +32767;
        if(sample < -32768) sample = -32768;
        sample = ((sample * fader_buffer) + (1 << 13)) >> 14;
        (*dst)[ch] = sample;
      }

      /*
      // Kept for reference - one-stage polyphase interpolation
      const int32_t *kernel = src_polyphase_filterbank[(src_phase / (0x40000000 / SRCPP_PHASES))];
      for(uint8_t ch = 0; ch < 2; ch++) {
        int32_t sample = 0;
        if(fader || fader_commanded) {
          // TODO: Not enough CPU to convolve while playing MP3, but currently MP3 is only played when fader is 0
          //       Instead, switch to a shorter kernel when playing MP3 so both can run concurrently, much nicer.
          sample = convolve_q16q32_circular(&(*src)[ch], 1, (int16_t *)buffer, buffer_end, kernel, SRCPP_TAPS);
          sample += (1 << (SRCPP_Q - 17)); // Apply rounding correction
          // Apply dithering
          if(shaped_dither) {
          sample += (shaped_noise(ch) >> (32 - SRCPP_Q)) + noise_error[ch];
          noise_error[ch] = sample - ((sample >> (SRCPP_Q - 16)) << (SRCPP_Q - 16));
        }
          // Scale, saturate, fade, write
          sample >>= (SRCPP_Q - 16);
          if(sample > +32767) sample = +32767;
          if(sample < -32768) sample = -32768;
          sample = (sample * fader_buffer) >> 14;
        }
        (*dst)[ch] = sample;
      }
      */

    } else if(cubic_src) {
      // ...cubic interpolation (ok, but "smeary")
      typeof(src) _src[4];
      _src[0] = src;
      _src[1] = _src[0] + 1; if(_src[1] >= (typeof(src))buffer_end) _src[1] = (typeof(src))buffer;
      _src[2] = _src[1] + 1; if(_src[2] >= (typeof(src))buffer_end) _src[2] = (typeof(src))buffer;
      _src[3] = _src[2] + 1; if(_src[3] >= (typeof(src))buffer_end) _src[3] = (typeof(src))buffer;
      (*dst)[0] = cubic((*_src[0])[0] << 8, (*_src[1])[0] << 8, (*_src[2])[0] << 8, (*_src[3])[0] << 8, (src_phase << 2)) >> 8;
      (*dst)[1] = cubic((*_src[0])[1] << 8, (*_src[1])[1] << 8, (*_src[2])[1] << 8, (*_src[3])[1] << 8, (src_phase << 2)) >> 8;
    } else if(linear_src) {
      // ...linear interpolation (ugh)
      typeof(src) _src[2];
      _src[0] = src;
      _src[1] = _src[0] + 1; if(_src[1] >= (typeof(src))buffer_end) _src[1] = (typeof(src))buffer;
      (*dst)[0] = linear((*_src[0])[0] << 8, (*_src[1])[0] << 8, (src_phase << 2)) >> 8;
      (*dst)[1] = linear((*_src[0])[1] << 8, (*_src[1])[1] << 8, (src_phase << 2)) >> 8;
    } else {
      // ...nearest neighbour (horrendous)
      (*dst)[0] = ((*src)[0] * fader_buffer) >> 14;
      (*dst)[1] = ((*src)[1] * fader_buffer) >> 14;
    }
    dst++;
    src_phase += src_rate_internal;  // Q30
    while(src_phase >= 0x40000000) {
      src_phase -= 0x40000000;
      if(++src >= (typeof(src))buffer_end) src = (typeof(src))buffer;

      // Perform 2x SRC up-sampling into micro-buffer
      if(polyphase_src) {
        for(uint8_t ch = 0; ch < 2; ch++) {
          typeof(src) src_mid = src + 7;
          if(src_mid >= (typeof(src))buffer_end) src_mid -= sizeof(buffer) / sizeof(typeof(src_mid));
          src_2x[src_2x_index + 0][ch] = (*(src_mid))[ch];
          int32_t sample = (convolve_q16q32_circular(&(*src)[ch], 1, (int16_t *)buffer, buffer_end, (int32_t*)src_2x_kernel, 16) + (1 << (SRC2X_Q - 17))) >> (SRC2X_Q - 16);
          if(sample > +32767) sample = +32767;
          if(sample < -32768) sample = -32768;
          src_2x[src_2x_index + 1][ch] = sample;
        }
        src_2x_index += 2;
        if(src_2x_index >= SRCPP_TAPS + 2) src_2x_index = 0;
      }

      bytes_read += 4;

      // Process input buffer fader - a quick and dirty linear fader with nearest-neighbour sampling for SRC
      // While not the highest quality, it only serves the purpose of smoothing instant cut-outs/ins for buffer underflows
      if(fadeout_from_index-- <= 0) {
        fader_buffer -= (16383 + SAMPLES(BUFFER_LOW)) / SAMPLES(BUFFER_LOW);  // round up
        if(fader_buffer < 0) fader_buffer = 0;
      } else {
        fader_buffer += 16384 / SAMPLES(BUFFER_LOW);
        if(fader_buffer > 16384) fader_buffer = 16384;
      }

    }
  }
  buffer_tail = (typeof(buffer_tail))src;

  // Update buffer level
  xSemaphoreTake(buffer_access, portMAX_DELAY);
  size_t _buffer_fill = buffer_fill - bytes_read;
  buffer_fill = _buffer_fill;
  xSemaphoreGive(buffer_access);

  // Track clock drift by...
  if(biquad_cdt) {
    //... PI regulator with feed-thru for calculated nominal, operating on buffer fill level over a 4th order LP 
    int32_t error = (int32_t)_buffer_fill - BUFFER_NOMINAL;
    int32_t filtered_error = biquadProcessQ(&cdt_history[0], &cdt_filter, biquadProcessQ(&cdt_history[1], &cdt_filter, error << 12)) >> 8;
    cdt_integrator += filtered_error;
    src_rate = src_nominal + (filtered_error << 6) + (cdt_integrator >> (AUDIO_CHUNK_SIZE_N));
  } else {
    //... unfiltered buffer fill level (fast, crappy, near useless)
    src_rate += ((int32_t)_buffer_fill - BUFFER_NOMINAL);
  }

  return AUDIO_CHUNK_SIZE;
}

// Read I²S stream
static size_t read_i2s_chunk(uint8_t *data) {
  size_t bytes_read;
  ESP_ERROR_CHECK(i2s_channel_read(rx_chan, (char *)data, AUDIO_CHUNK_SIZE, &bytes_read, portMAX_DELAY));
  return bytes_read;
}

// Write I²S stream
static size_t write_i2s_chunk(uint8_t *data) {
  size_t bytes_sent;
  ESP_ERROR_CHECK(i2s_channel_write(tx_chan, (char *)data, AUDIO_CHUNK_SIZE, &bytes_sent, portMAX_DELAY));
  return bytes_sent;
}

// Called when AVRC metadata arrives from the connected source
static void avrc_metadata_callback(uint8_t id, const uint8_t *text) {
  const char *data = (const char *)text;
  size_t length = strlen(data);
  if(cb_metadata) cb_metadata(id, data, length);
}

// Called when AVRC connection state changes
static void avrc_connection_state_callback(bool connected) {
  const char *data = a2dp_sink.get_peer_name();
  size_t length = strlen(data);
  if(cb_connection) cb_connection(connected, data, length);
}

// Event handler task - basically just a forwarder to a custom event handler
static void event_handler(void *dummy) {
    while (1) {
      audio_event e = Audio.getEvent();
      if(cb_eventhandler) cb_eventhandler(e);
    }
}

static void create_event_handler_task() {
  xTaskCreate(event_handler, "Audio Event Handler", 2048, NULL, 1, &eventHandler);
}

// Perform audio processing
// * input detection
// * synthesizing
// * routing
// * mixing
static void audio_processor(void *dummy) {

  audio_event e = EVT_READY;
  xQueueSend(eventQueue, &e, portMAX_DELAY);

  while(1) {

    if(a2dp_sink.is_connected()) {
      if(connected_counter == 0) {
        audio_event e = EVT_BT_CONNECT;
        xQueueSend(eventQueue, &e, portMAX_DELAY);
      }
      if(connected_counter < 4000) {
        if(++connected_counter == 4000) {
          a2dp_sink.set_discoverability(ESP_BT_GENERAL_DISCOVERABLE);
        }
      }
    } else {
      if(connected_counter) {
        audio_event e = EVT_BT_DISCONNECT;
        xQueueSend(eventQueue, &e, portMAX_DELAY);
      }
      connected_counter = 0;
    }

    // Check A2DP buffer, switch streaming on/off by hysteresis
    size_t a2dp_available = read_a2dp_chunk(NULL);
    if(streaming) {
      if(a2dp_available < AUDIO_CHUNK_SIZE) {
        streaming = false;
        streaming_stable = STABILITY_COUNT_OUT;
        cdt_reset();
        audio_event e = EVT_BT_STOP;
        xQueueSend(eventQueue, &e, portMAX_DELAY);
      }
    } else {
      if(a2dp_available >= BUFFER_NOMINAL) {
        streaming = true;
        streaming_stable = STABILITY_COUNT_IN;
        audio_event e = EVT_BT_START;
        xQueueSend(eventQueue, &e, portMAX_DELAY);
      }
    }

    // If source is not I2S, read it first to maintain timing
    // Actual source will overwrite the chunk later
    if(source != SRC_ANALOG) read_i2s_chunk(chunk);

    if(streaming) {

      // If streaming from the A2DP buffer, process it now
      // We need to prevent overflows and track clock drift even when it's not the source
      // Actual source will overwrite the chunk later
      read_a2dp_chunk(chunk);

    } else if(source == SRC_BT) {

      // Mute the chunk when A2DP is the source but is not streaming properly
      memset(chunk, 0, sizeof(chunk));
    }

    // If source is I2S, read it last
    if(source == SRC_ANALOG) read_i2s_chunk(chunk);

    // Callback for input audio data
    if(cb_audiodata) cb_audiodata((int16_t *)chunk, true);

    // Switch sources after streaming state appears stable
    if(streaming_stable) {
      if(!--streaming_stable) {
        audio_event e = EVT_BT_STABLE;
        xQueueSend(eventQueue, &e, portMAX_DELAY);
      }
    }

    // Instant commanded fades when buffer fader is fully engaged
    if(fader_buffer == 0 && fader != fader_commanded) {
      fader = fader_commanded;
    }

    // Handle synthesis request
    if(synthesis_request) {

      synthesis = true;
      synthesis_request = false;
      if(synthesis_mp3_size) {
        if(mp3_decoder) MP3FreeDecoder(mp3_decoder);
        mp3_decoder = MP3InitDecoder();
        mp3_buffer_index = mp3_buffer_fill = 0;
        mp3_data = (typeof(mp3_data))synthesis_mp3_data;
        mp3_size = (typeof(mp3_size))synthesis_mp3_size;
        synthesis_mp3_size = 0;
      } else if(synthesis_sweep_seed.t) {
        synthesis_sweep_data = synthesis_sweep_seed;
        synthesis_sweep_seed.t = 0;
      } else {
        synthesis = false;
      }

    }

    // Process samples
    int16_t *ch = (int16_t *)chunk;
    for(int32_t n = 0; n < SAMPLES(AUDIO_CHUNK_SIZE); n++, ch += 2) {

      // Process application fader
      if(fader < fader_commanded) {
        fader++;
      } else if(fader > fader_commanded) {
        fader--;
      }

      // Fading complete event
      if(fader == fader_commanded && fade_request) {
        fade_request = false;
        audio_event e = EVT_FADE_DONE;
        xQueueSend(eventQueue, &e, portMAX_DELAY);
      }

      // Apply fader using a cosine profile to eliminate the zipper effect
      uint32_t fade = (cosine((fader << 17) + 0x80000000) >> 17) + 8192;
      ch[0] = ((int32_t)ch[0] * fade) >> 14;
      ch[1] = ((int32_t)ch[1] * fade) >> 14;

      if(synthesis) {
        bool synth_done = false;
        if(mp3_size || mp3_buffer_index < mp3_buffer_fill) {

          // Decode MP3
          if(mp3_buffer_index >= mp3_buffer_fill) {
            int offset = MP3FindSyncWord(mp3_data, mp3_size);
            if(offset < 0) {
              synth_done = true;
            } else {
              mp3_data += offset;
              mp3_size -= offset;
              if(MP3Decode(mp3_decoder, (unsigned char**)&mp3_data, &mp3_size, mp3_buffer, 0) == ERR_MP3_NONE) {
                MP3GetLastFrameInfo(mp3_decoder, &mp3_info);
                mp3_buffer_index = 0;
                mp3_buffer_fill = mp3_info.outputSamps;
              } else {
                synth_done = true;
              }
            }
          }
          if(synth_done) {
            if(mp3_decoder) MP3FreeDecoder(mp3_decoder);
            mp3_size = 0;
            mp3_buffer_index = 0;
            mp3_buffer_fill = 0;
          } else {
            if(mp3_info.nChans == 2) {
              ch[0] += mp3_buffer[mp3_buffer_index++] >> 2;
              ch[1] += mp3_buffer[mp3_buffer_index++] >> 2;
            } else {
              ch[0] += mp3_buffer[mp3_buffer_index  ] >> 2;
              ch[1] += mp3_buffer[mp3_buffer_index++] >> 2;
            }
          }

        } else if(synthesis_sweep_data.t) {
          
          // Approximate log-sweep by blazing fast fixed point
          synthesis_sweep_data.t--;
          uint32_t b32_mod = (uint64_t)((synthesis_sweep_data.b32v - (0x40000000 >> synthesis_sweep_data.b32q)) * (uint64_t)synthesis_sweep_data.f32 << synthesis_sweep_data.b32q >> 12);
          int32_t sample = sine(b32_mod);
          sample = (sample + (1 << 16)) >> 17;
          synthesis_sweep_data.b32v = smmlar(synthesis_sweep_data.b32v, synthesis_sweep_data.b32, synthesis_sweep_data.b32v);
          if(synthesis_sweep_data.b32v < 0) {
            synthesis_sweep_data.b32v = (uint32_t)synthesis_sweep_data.b32v >> 1;
            synthesis_sweep_data.b32q++;
          }
          ch[0] += sample;
          ch[1] += sample;

        } else {
          
          // TODO: Add other synthesis methods here
          synth_done = true;

        }
        if(synth_done) {
          synthesis = false;
          audio_event e = EVT_SYNTH_DONE;
          xQueueSend(eventQueue, &e, portMAX_DELAY);
        }
      }
    }

    // Callback for output audio data
    if(cb_audiodata) cb_audiodata((int16_t *)chunk, false);

    // Write audio to I2S
    write_i2s_chunk(chunk);
  }
}

// Initialize audio driver
void Audio_Driver::init(const char *name, audio_samplerate samplerate, bool preemption, bool mclk) {

  // Free some unused memory allocated to BLE (which we will never use)
  //esp_bt_mem_release(ESP_BT_MODE_BLE); // 4,728 freed => 178000 total on 3.0.7

  sink_samplerate = samplerate;

  buffer_access = xSemaphoreCreateBinary();
  xSemaphoreGive(buffer_access);

  // Start I²S
  if(mclk) {
    i2s_device.setPins(I2S_BCK, I2S_WCK, I2S_TXD, I2S_RXD, I2S_MCK);
    //gpio_set_drive_capability(I2S_MCK, GPIO_DRIVE_CAP_2);  // Changing this may vastly improve signal integrity
  } else {
    i2s_device.setPins(I2S_BCK, I2S_WCK, I2S_TXD, I2S_RXD);
  }
  if(!i2s_device.begin(I2S_MODE_STD, samplerate, I2S_DATA_BIT_WIDTH_16BIT, I2S_SLOT_MODE_STEREO, I2S_STD_SLOT_BOTH)) ESP_ERROR_CHECK(ESP_FAIL);

  // Start A2DP Bluetooth service
  a2dp_sink.set_avrc_metadata_attribute_mask(ESP_AVRC_MD_ATTR_TITLE | ESP_AVRC_MD_ATTR_ARTIST | ESP_AVRC_MD_ATTR_ALBUM | ESP_AVRC_MD_ATTR_PLAYING_TIME);
  a2dp_sink.set_avrc_metadata_callback(avrc_metadata_callback);
  a2dp_sink.set_avrc_connection_state_callback(avrc_connection_state_callback);
  //a2dp_sink.set_avrc_rn_playstatus_callback(avrc_rn_playstatus_callback);
  //a2dp_sink.set_avrc_rn_play_pos_callback(avrc_rn_play_pos_callback);
  
  // This delay prevents crashes due to excessive CPU use when A2DPSink wants to write to a full buffer
  a2dp_sink.set_max_write_delay_ms(1);
  
  a2dp_sink.start(name);
  
  // Allow incoming connections to disconnect current connection (take over)
  a2dp_sink.enable_preemption(preemption);

  // Configure source clock drift filter
  biquad_filter f = biquadMake(FILTER_LOWPASS, (float)samplerate / SAMPLES(AUDIO_CHUNK_SIZE), 1.0, 0.7);
  cdt_filter = biquadQ(&f, 30);

  // Fetch channels for lower-layer I2S access
  rx_chan = i2s_device.rxChan();
  tx_chan = i2s_device.txChan();

  // Create event queue
  eventQueue = xQueueCreate(EVENT_QUEUE_SIZE, sizeof(audio_event));

  // Create event handler task if a callback was registered before init.
  if(cb_eventhandler) {
    create_event_handler_task();
  }
  
}

// Start everything
void Audio_Driver::begin() {
  // Create application
  xTaskCreate(audio_processor, "Audio Processor", 1024, NULL, 1, NULL);
}

// Play MP3
void Audio_Driver::startSynthMP3(res_id mp3) {
  if(synthesis_request) return;
  const unsigned char *data = resourceData(mp3);
  size_t size = resourceSize(mp3);
  if(!data || size == 0) return;
  synthesis_mp3_data = data;
  synthesis_mp3_size = size;
  synthesis_request = true;
}

// Play log-sweep
void Audio_Driver::startSynthSweep(sweep_data seed) {
  if(synthesis_request) return;
  synthesis_sweep_seed = seed;
  synthesis_request = true;
}

// Return source to sink sample rate ratio as its fraction
float Audio_Driver::samplerateRatio() {
  return (float)src_rate / 0x40000000;
}

// Return source (remote) samplerate (as reported, not measured)
uint16_t Audio_Driver::samplerateSource() {
  return source_samplerate;
}

// Return sink (local) samplerate
uint16_t Audio_Driver::samplerateSink() {
  return sink_samplerate;
}

// Return current buffer level (0-1)
float Audio_Driver::bufferLevel() {
  return (float)buffer_fill / BUFFER_SIZE;
}

// Get current audio source
audio_source Audio_Driver::currentSource() {
  return (audio_source)source;
}

// Set meta data callback function
void Audio_Driver::setMetaHandler(void (*cb)(uint8_t, const char *, size_t)) {
  cb_metadata = cb;
}

// Set connection state callback function
void Audio_Driver::setConnectionHandler(void (*cb)(bool, const char *, size_t)) {
  cb_connection = cb;
}

// Set audio data callback function
void Audio_Driver::setAudioHandler(void (*cb)(int16_t *, bool)) {
  cb_audiodata = cb;
}

// Get next audio event from queue
audio_event Audio_Driver::getEvent() {
  audio_event e;
  xQueueReceive(eventQueue, &e, portMAX_DELAY);
  return e;
}

// Post custom events
void Audio_Driver::postEvent(int ie) {
  audio_event e = (audio_event)ie;
  xQueueSend(eventQueue, &e, portMAX_DELAY);
}

// Begin fading (will always result in a FADE_DONE event)
void Audio_Driver::startFade(float volume) {
  fader_commanded = 16384 * volume;
  fade_request = true;
}

// Switch audio source
void Audio_Driver::setSource(audio_source s) {
  source = s;
}

// Get current audio source
audio_source Audio_Driver::getSource() {
  return source;
}

// Send an AVRC command
void Audio_Driver::sendCommand(audio_command command) {
  switch(command) {
    case CMD_PLAY:   a2dp_sink.play();         break;
    case CMD_PAUSE:  a2dp_sink.pause();        break;
    case CMD_STOP:   a2dp_sink.stop();         break;
    case CMD_NEXT:   a2dp_sink.next();         break;
    case CMD_PREV:   a2dp_sink.previous();     break;
    case CMD_FWD:    a2dp_sink.fast_forward(); break;
    case CMD_REW:    a2dp_sink.rewind();       break;
    case CMD_VOLINC: a2dp_sink.volume_up();    break;
    case CMD_VOLDEC: a2dp_sink.volume_down();  break;
    default: break;
  }
}

void Audio_Driver::sendCommand(audio_command command, bool pressed) {
  esp_avrc_pt_cmd_t avrc_cmd;
  switch(command) {
    case CMD_PLAY:   avrc_cmd = ESP_AVRC_PT_CMD_PLAY;         break;
    case CMD_PAUSE:  avrc_cmd = ESP_AVRC_PT_CMD_PAUSE;        break;
    case CMD_STOP:   avrc_cmd = ESP_AVRC_PT_CMD_STOP;         break;
    case CMD_NEXT:   avrc_cmd = ESP_AVRC_PT_CMD_FORWARD;      break;
    case CMD_PREV:   avrc_cmd = ESP_AVRC_PT_CMD_BACKWARD;     break;
    case CMD_FWD:    avrc_cmd = ESP_AVRC_PT_CMD_FAST_FORWARD; break;
    case CMD_REW:    avrc_cmd = ESP_AVRC_PT_CMD_REWIND;       break;
    case CMD_VOLINC: avrc_cmd = ESP_AVRC_PT_CMD_VOL_UP;       break;
    case CMD_VOLDEC: avrc_cmd = ESP_AVRC_PT_CMD_VOL_DOWN;     break;
    default: return;
  }
  esp_avrc_ct_send_passthrough_cmd(0, avrc_cmd, pressed ? ESP_AVRC_PT_CMD_STATE_PRESSED : ESP_AVRC_PT_CMD_STATE_RELEASED);
}

// Set audio event handler
  void Audio_Driver::setEventHandler(void (*cb)(audio_event)) {
    cb_eventhandler = cb;
    if(!eventQueue) return;
    if(eventHandler) {
      if(!cb) {
      	// Delete event handler
        vTaskDelete(eventHandler);
        eventHandler = NULL;
      }
    } else {
      if(cb) {
      	// Create event handler
        create_event_handler_task();
      }
    }
  }

// Disconnect current user
void Audio_Driver::disconnectBluetooth() {
  a2dp_sink.disconnect();
}
